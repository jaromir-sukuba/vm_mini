#include "disp.h"
#include "hw.h"

extern unsigned char lcd_pix_buffer[132*4];

const char font5x7[455] =
   {0x00, 0x00, 0x00, 0x00, 0x00 ,  // sp
    0x00, 0x00, 0x2f, 0x00, 0x00 ,  // !
    0x00, 0x07, 0x00, 0x07, 0x00 ,  // "
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    0x44, 0x64, 0x54, 0x4C, 0x44};  // z

// ascii table, starting with character blank (32)
// size is 8x14
const unsigned char ascii_tab[96][14] = {
{ 0x00, 0x00, 0x00, 0x00, 0x00, 0x00, 0x00, 0x00, 0x00, 0x00, 0x00, 0x00, 0x00, 0x00}, // space (32)
{ 0x00, 0x00, 0x00, 0x18, 0x3c, 0x3c, 0x3c, 0x18, 0x18, 0x00, 0x18, 0x18, 0x00, 0x00}, //!
{ 0x00, 0x66, 0x66, 0x66, 0x24, 0x00, 0x00, 0x00, 0x00, 0x00, 0x00, 0x00, 0x00, 0x00}, //"
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{ 0x00, 0x00, 0x00, 0x00, 0x00, 0x10, 0x38, 0x6c, 0xc6, 0xc6, 0xfe, 0x00, 0x00, 0x00},
};



void print_char_b (unsigned char data,unsigned char x,unsigned char y,unsigned char invert)
{
unsigned char temp2,i,offset;
unsigned int col;
unsigned int addr, invert_mask;
if (invert==0) invert_mask = 0;
else  invert_mask = 0xFFFF;
for (offset=0;offset<8;offset++)
{
	col = 0;
	for (i=0;i<14;i++)
	{
		temp2 = ascii_tab[(data -' ')][i];
		col = col>>1;
		if ((temp2>>offset)&0x01) col = col|0x2000;
	}
//	col = ~col;
	col = col ^ invert_mask;
	addr = ((unsigned int)(x+1))*132 + y + (7-offset);
	lcd_pix_buffer[addr] = (col>>8);
	addr = ((unsigned int)(x+0))*132 + y + (7-offset);
	lcd_pix_buffer[addr] = (col&0x00FF);

}
}


void print_char (unsigned char data, unsigned char x, unsigned char y, unsigned char invert)
{
unsigned int addr;
unsigned char invert_mask;
if (invert==0) invert_mask = 0;
else  invert_mask = 0xFF;
addr = ((unsigned int)(x))*132 + y;
lcd_pix_buffer[addr] = font5x7[(((unsigned int)(data))-' ') * 5]^ invert_mask;
lcd_pix_buffer[addr+1] = font5x7[(((unsigned int)(data))-' ') * 5+1]^ invert_mask;
lcd_pix_buffer[addr+2] = font5x7[(((unsigned int)(data))-' ') * 5+2]^ invert_mask;
lcd_pix_buffer[addr+3] = font5x7[(((unsigned int)(data))-' ') * 5+3]^ invert_mask;
lcd_pix_buffer[addr+4] = font5x7[(((unsigned int)(data))-' ') * 5+4]^ invert_mask;
lcd_pix_buffer[addr+5] = 0 ^ invert_mask;
}


unsigned char print_str (char *dat, unsigned char line, unsigned char off, unsigned char type, unsigned char invert)
{
unsigned char y,width;
y=off;
if (type==BIG) width=8;
else if (type==SMALL) width=6;
	else return 255;

//if (type==BIG) line = line>>1;
while (*dat!=0x00)
	{
	if (type==BIG) print_char_b(*dat,line,y,invert);
	if (type==SMALL) print_char(*dat,line,y,invert);
	y = y+width;
	if (y>131) return(0);
	*dat++;
	}
return y;
}

void spi_data (uint8_t data)
    {
    uint8_t i;
    for (i=0;i<8;i++)
	{
	if (data&0x80)
	    {
	    D_SI_H;
	    }
	else
	    {
	    D_SI_L;
	    }
	D_CLK_L;
	data = data << 1;
	D_CLK_H;
	}
    }

void disp_cmd (uint8_t data)
    {
    D_CS_L;
    D_A0_L;
    spi_data(data);
    D_CS_H;
    }

void disp_dat (uint8_t data)
    {
    D_CS_L;
    D_A0_H;
    spi_data(data);
    D_CS_H;
    }

void disp_init (void)
    {
    D_RST_L;
    D_RST_H;
    disp_cmd(0x40);
    disp_cmd(0xA1);
    disp_cmd(0xC0);
    disp_cmd(0xA6);
    disp_cmd(0xA2);
    disp_cmd(0x2F);
    disp_cmd(0xF8);
    disp_cmd(0x00);
    disp_cmd(0x23);
    disp_cmd(0x81);
    disp_cmd(0x1F);
    disp_cmd(0xAC);
    disp_cmd(0x00);
    disp_cmd(0xAF);
    }


void set_pixel (unsigned char x, unsigned char y, unsigned char color)
{
unsigned int addr;
unsigned char shift,mask;
addr = (x) + (y/8)*132;
shift = y%8;
mask = 1<<shift;
if (color==0)
	{
	lcd_pix_buffer[addr] = lcd_pix_buffer[addr] & (~mask);
	}
if (color==1)
	{
	lcd_pix_buffer[addr] = lcd_pix_buffer[addr] | mask;
	}
if (color==2)
	{
	lcd_pix_buffer[addr] = lcd_pix_buffer[addr] ^ mask;
	}

}

void fill_disp_buff (unsigned char data)
{
unsigned char j;
unsigned int i=0;
for (j=0;j<132;j++)
    {
        lcd_pix_buffer[i++]=data;
        lcd_pix_buffer[i++]=data;
        lcd_pix_buffer[i++]=data;
        lcd_pix_buffer[i++]=data;
    }
}
/*
void refresh_lcd(void)
{
unsigned int i,j,addr;
for (i=0;i<4;i++)
	{
	disp_cmd(0x10);
	disp_cmd(0x00);
	disp_cmd(0xB0+i);
	for (j=0;j<132;j++)
		{
		addr = (i*132) + j;
		disp_dat(lcd_pix_buffer[addr]);
		}
	}
}
*/

void refresh_lcd(void)
{
unsigned int i,j,addr;
for (i=0;i<4;i++)
	{
	disp_cmd(0x10);
	disp_cmd(0x00);
	disp_cmd(0xB0+i);
	D_A0_H;
	D_CS_L;
	for (j=0;j<132;j++)
		{
		addr = (i*132) + j;
		spi_data(lcd_pix_buffer[addr]);
		}
	D_CS_H;
	}
}

void refresh_lcd_p(void)
{
unsigned int j,addr;
static row_cnt;
row_cnt++;
if (row_cnt>4) row_cnt=0;
disp_cmd(0x10);
disp_cmd(0x00);
disp_cmd(0xB0+row_cnt);
D_A0_H;
D_CS_L;
for (j=0;j<132;j++)
    {
    addr = (row_cnt*132) + j;
    spi_data(lcd_pix_buffer[addr]);
    }
D_CS_H;
}

void refresh_lcd_line(uint8_t line, uint8_t row)
{
unsigned int j,addr;
disp_cmd(0x10 + ((row>>4)&0x0F));
disp_cmd(0x00 + ((row>>0)&0x0F));
disp_cmd(0xB0+line);
D_A0_H;
D_CS_L;
for (j=row;j<132;j++)
    {
    addr = (line*132) + j;
    spi_data(lcd_pix_buffer[addr]);
    }
D_CS_H;
}
